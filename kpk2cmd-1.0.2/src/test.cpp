/****************************************************************************
** Image collection for project 'kpk2cmd'.
**
** Generated from reading image files: 
**      spin1.png
**      spin2.png
**      spin3.png
**      spin4.png
**      spin5.png
**      spin6.png
**      spin7.png
**      spin8.png
**      run.png
**      stop.png
**
** Created: Mon Mar 24 19:21:32 2008
**      by: The User Interface Compiler ($Id: qt/embed.cpp   3.3.7   edited Aug 31 2005 $)
**
** WARNING! All changes made in this file will be lost!
****************************************************************************/

#include <qimage.h>
#include <qdict.h>
#include <qmime.h>
#include <qdragobject.h>

// spin1.png
static const unsigned char image_0_data[] = {
    0x00,0x00,0x19,0x00,0x78,0x9c,0xed,0xd1,0xdd,0x0d,0xc2,0x30,0x0c,0x46,
    0x51,0x36,0x61,0x14,0x46,0x61,0x14,0x46,0x61,0x14,0x46,0x61,0x14,0x93,
    0x3c,0x58,0x42,0xa5,0xb5,0x3f,0xa7,0xfe,0x81,0x12,0x4b,0xb7,0x2f,0xa9,
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    0x1d,0xad,0x17,0x2d,0x9f,0x53,0x21
};

// spin2.png
static const unsigned char image_1_data[] = {
    0x00,0x00,0x19,0x00,0x78,0x9c,0xed,0xd1,0xdd,0x0d,0xc2,0x30,0x0c,0x46,
    0x51,0x36,0x61,0x14,0x46,0x61,0x14,0x46,0x61,0x14,0x46,0x61,0x14,0x93,
    0x3c,0x58,0x42,0xa5,0xb5,0x3f,0xa7,0xfe,0x81,0x12,0x4b,0xf7,0x29,0x51,
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    0xd6,0x0b,0x00,0xba,0x54,0x21
};

// spin3.png
static const unsigned char image_2_data[] = {
    0x00,0x00,0x19,0x00,0x78,0x9c,0xed,0xd1,0xdd,0x0d,0xc2,0x30,0x0c,0x46,
    0x51,0x36,0x61,0x14,0x46,0x61,0x14,0x46,0x61,0x14,0x46,0x61,0x14,0x93,
    0x3c,0x58,0x42,0xa5,0xb5,0x3f,0xa7,0xfe,0x81,0x12,0x4b,0xf7,0x29,0x51,
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    0xd6,0x0b,0x77,0x5b,0x53,0x21
};

// spin4.png
static const unsigned char image_3_data[] = {
    0x00,0x00,0x19,0x00,0x78,0x9c,0xed,0xd1,0xdd,0x0d,0xc2,0x30,0x0c,0x46,
    0x51,0x36,0x61,0x14,0x46,0x61,0x14,0x46,0x61,0x14,0x46,0x61,0x14,0x93,
    0x3c,0x58,0x42,0xa5,0xb5,0x3f,0xa7,0xfe,0x81,0x12,0x4b,0xf7,0x29,0x51,
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    0xd6,0x0b,0x92,0xc4,0x54,0x21
};

// spin5.png
static const unsigned char image_4_data[] = {
    0x00,0x00,0x19,0x00,0x78,0x9c,0xed,0xd4,0xd1,0x0d,0xc3,0x20,0x0c,0x45,
    0xd1,0x6c,0x92,0x51,0x3a,0x4a,0x46,0xe9,0x28,0x19,0xa5,0xa3,0x64,0x94,
    0x56,0x4f,0x8a,0x25,0x8a,0xc0,0xd8,0x18,0x4c,0xda,0x70,0xa5,0xf7,0x15,
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    0x67,0xd3,0x67,0x6b,0xfa,0x2e,0xd6,0x07,0xcf,0x4e,0x8a,0x09
};

// spin6.png
static const unsigned char image_5_data[] = {
    0x00,0x00,0x19,0x00,0x78,0x9c,0xed,0xd1,0xdd,0x0d,0xc2,0x30,0x0c,0x46,
    0x51,0x36,0x61,0x14,0x46,0x61,0x14,0x46,0x61,0x14,0x46,0x61,0x14,0x93,
    0x3c,0x58,0x42,0xa5,0xb5,0x3f,0xa7,0xfe,0x81,0x12,0x4b,0xf7,0x29,0x51,
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    0xd6,0x0b,0x48,0x90,0x54,0x21
};

// spin7.png
static const unsigned char image_6_data[] = {
    0x00,0x00,0x19,0x00,0x78,0x9c,0xed,0xd4,0xd1,0x0d,0xc3,0x20,0x0c,0x45,
    0xd1,0x6c,0x92,0x51,0x3a,0x4a,0x46,0xe9,0x28,0x19,0xa5,0xa3,0x64,0x94,
    0x56,0x4f,0x8a,0x25,0x8a,0xc0,0xd8,0x18,0x4c,0xda,0x70,0xa5,0xf7,0x15,
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    0x67,0xd3,0x67,0x6b,0xfa,0x2e,0xd6,0x07,0x85,0x92,0x8a,0x09
};

// spin8.png
static const unsigned char image_7_data[] = {
    0x00,0x00,0x19,0x00,0x78,0x9c,0xed,0xd1,0xdd,0x0d,0xc2,0x30,0x0c,0x46,
    0x51,0x36,0x61,0x14,0x46,0x61,0x14,0x46,0x61,0x14,0x46,0x61,0x14,0x93,
    0x3c,0x58,0x42,0xa5,0xb5,0x3f,0xa7,0xfe,0x81,0x12,0x4b,0xf7,0x29,0x51,
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    0xd6,0x0b,0xb6,0x77,0x54,0x21
};

// run.png
static const unsigned char image_8_data[] = {
    0x00,0x00,0x1b,0x90,0x78,0x9c,0xe5,0x99,0xc7,0x4a,0xb4,0x59,0x10,0x86,
    0xff,0x89,0x32,0xd7,0x20,0x82,0x2e,0x5d,0xb8,0x50,0xd0,0xad,0x4b,0x37,
    0x22,0x88,0x57,0x20,0x2e,0x14,0xc1,0x9b,0x70,0xe1,0x52,0x71,0x30,0x81,
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    0xff,0xcd,0x7c,0xa5,0xfe,0x01,0x6d,0xaa,0x3b,0xc8
};

// stop.png
static const unsigned char image_9_data[] = {
    0x00,0x00,0x1b,0x90,0x78,0x9c,0xe5,0x99,0xe7,0x4a,0x2b,0x61,0x10,0x86,
    0x4f,0x17,0x39,0x57,0x25,0x5e,0x84,0xe2,0x1f,0xef,0xc0,0xcb,0xf0,0xa7,
    0x41,0xb0,0x81,0x0d,0x7b,0x89,0x8a,0x62,0xef,0x0a,0xf6,0x86,0x8a,0x62,
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    0x7a,0x73
};

static struct EmbedImage {
    int width, height, depth;
    const unsigned char *data;
    ulong compressed;
    int numColors;
    const QRgb *colorTable;
    bool alpha;
    const char *name;
} embed_image_vec[] = {
    { 40, 40, 32, (const unsigned char*)image_0_data, 217, 0, 0, TRUE, "spin1.png" },
    { 40, 40, 32, (const unsigned char*)image_1_data, 216, 0, 0, TRUE, "spin2.png" },
    { 40, 40, 32, (const unsigned char*)image_2_data, 216, 0, 0, TRUE, "spin3.png" },
    { 40, 40, 32, (const unsigned char*)image_3_data, 216, 0, 0, TRUE, "spin4.png" },
    { 40, 40, 32, (const unsigned char*)image_4_data, 236, 0, 0, TRUE, "spin5.png" },
    { 40, 40, 32, (const unsigned char*)image_5_data, 216, 0, 0, TRUE, "spin6.png" },
    { 40, 40, 32, (const unsigned char*)image_6_data, 236, 0, 0, TRUE, "spin7.png" },
    { 40, 40, 32, (const unsigned char*)image_7_data, 216, 0, 0, TRUE, "spin8.png" },
    { 42, 42, 32, (const unsigned char*)image_8_data, 1172, 0, 0, TRUE, "run.png" },
    { 42, 42, 32, (const unsigned char*)image_9_data, 982, 0, 0, TRUE, "stop.png" },
    { 0, 0, 0, 0, 0, 0, 0, 0, 0 }
};

 QImage uic_findImage( const QString& name )
{
    for ( int i=0; embed_image_vec[i].data; i++ ) {
	if ( QString::fromUtf8(embed_image_vec[i].name) == name ) {
	    QByteArray baunzip;
	    baunzip = qUncompress( embed_image_vec[i].data, 
		embed_image_vec[i].compressed );
	    QImage img((uchar*)baunzip.data(),
			embed_image_vec[i].width,
			embed_image_vec[i].height,
			embed_image_vec[i].depth,
			(QRgb*)embed_image_vec[i].colorTable,
			embed_image_vec[i].numColors,
			QImage::BigEndian
		);
	    img = img.copy();
	    if ( embed_image_vec[i].alpha )
		img.setAlphaBuffer(TRUE);
	    return img;
        }
    }
    return QImage();
}

class MimeSourceFactory_kpk2cmd : public QMimeSourceFactory
{
public:
    MimeSourceFactory_kpk2cmd() {}
    ~MimeSourceFactory_kpk2cmd() {}
    const QMimeSource* data( const QString& abs_name ) const {
	const QMimeSource* d = QMimeSourceFactory::data( abs_name );
	if ( d || abs_name.isNull() ) return d;
	QImage img = uic_findImage( abs_name );
	if ( !img.isNull() )
	    ((QMimeSourceFactory*)this)->setImage( abs_name, img );
	return QMimeSourceFactory::data( abs_name );
    };
};

static QMimeSourceFactory* factory = 0;

void qInitImages_kpk2cmd()
{
    if ( !factory ) {
	factory = new MimeSourceFactory_kpk2cmd;
	QMimeSourceFactory::defaultFactory()->addFactory( factory );
    }
}

void qCleanupImages_kpk2cmd()
{
    if ( factory ) {
	QMimeSourceFactory::defaultFactory()->removeFactory( factory );
	delete factory;
	factory = 0;
    }
}

class StaticInitImages_kpk2cmd
{
public:
    StaticInitImages_kpk2cmd() { qInitImages_kpk2cmd(); }
#if defined(Q_OS_SCO) || defined(Q_OS_UNIXWARE)
    ~StaticInitImages_kpk2cmd() { }
#else
    ~StaticInitImages_kpk2cmd() { qCleanupImages_kpk2cmd(); }
#endif
};

static StaticInitImages_kpk2cmd staticImages;
